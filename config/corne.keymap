#define CONFIG_WIRELESS
#define ZMK_BASE_LAYER(name, LT, RT, LM, RM, LB, RB, LH, RH)                   \
    ZMK_LAYER(                                                                 \
        name,                                                                  \
                &kp ESC      LT  RT &out OUT_TOG                                       \
                &kp BSPC     LM  RM &none                                              \
                CMD_UNDO     LB  RB &none                                              \
                LH_OUTER_##name LH RH &siri                                    \
    )

// Outer-left thumb: Globe everywhere except Num, where it's Tab.
#define LH_OUTER_Base  &kp GLOBE
#define LH_OUTER_Nav   &kp GLOBE
#define LH_OUTER_Fn    &kp GLOBE
#define LH_OUTER_Num   &kp TAB
#define LH_OUTER_Sys   &kp GLOBE
#define LH_OUTER_Mouse &kp GLOBE

#include "zmk-helpers/key-labels/42.h"
#include "base.keymap"

// Siri: holds Globe+S for as long as the key is held (tap = type to Siri,
// hold = talk to Siri), like Apple's mic key.
ZMK_MACRO(siri,
    bindings = <&macro_press &kp GLOBE &kp S>,
               <&macro_pause_for_release>,
               <&macro_release &kp S &kp GLOBE>;)

/{ chosen { zmk,physical-layout = &foostan_corne_6col_layout; }; };
