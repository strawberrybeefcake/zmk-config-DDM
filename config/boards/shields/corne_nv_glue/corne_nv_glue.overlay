/*
 * SPDX-License-Identifier: MIT
 *
 * "Glue" shield for the Nice!View Corne set:
 *
 *     corne_left  nice_view_adapter  corne_nv_glue  nice_view
 *     corne_right nice_view_adapter  corne_nv_glue  nice_view
 *
 * On the ZMK board variant (nice_nano//zmk), nice_view_adapter's own
 * boards/nice_nano_nrf52840_zmk.overlay already defines &nice_view_spi
 * (SCK P0.20, MOSI P0.17, CS pro_micro 1). This shield used to define it
 * too, which was only needed while builds targeted the generic nice_nano
 * board.
 *
 * What's left: the corne shield's nice_nano_nrf52840_zmk.overlay puts an
 * underglow LED strip on spi3 with MOSI on P0.06 = pro_micro 1, which is
 * the nice!view CS pin. There's no underglow on this set, so turn spi3 off.
 * The widget overrides in corne_nv_glue.conf still apply.
 */

&spi3 {
    status = "disabled";
};
